## drivers/learning/Kconfig
```kconfig
# SPDX-License-Identifier: GPL-2.0
menuconfig LEARNING_DRIVERS
	bool "Learning drivers (local experiments)"
	help
	  Enable local learning drivers used for kernel debugging practice.
	  This menu is intended for iterative experiments (for example in
	  QEMU/i.MX6UL) and can be extended with more driver categories later.

if LEARNING_DRIVERS

source "drivers/learning/chardev/Kconfig"

endif
```

## drivers/learning/chardev/Kconfig
```kconfig
# SPDX-License-Identifier: GPL-2.0
menu "Learning character devices"

config LEARNING_CHARDEV
	tristate "Simple learning character device"
	help
	  Build a tiny character-device example for driver learning and
	  GDB practice.

	  Device node:
	    /dev/learn_char0

	  Useful GDB breakpoints:
	    learn_char_init
	    learn_char_open
	    learn_char_read
	    learn_char_write
	    learn_char_release

endmenu
```
